## arch/arm/configs/ok6410A_sdboot_mini_net_lcd_defconfig
```kconfig
CONFIG_ARCH_MULTI_V6=y
CONFIG_ARCH_S3C64XX=y
CONFIG_MACH_SMDK6410=y
CONFIG_SERIAL_SAMSUNG=y
CONFIG_SERIAL_SAMSUNG_CONSOLE=y
CONFIG_MMC=y
CONFIG_MMC_SDHCI=y
CONFIG_MMC_SDHCI_S3C=y
CONFIG_EXT3_FS=y


#### add for mount: mdev: unknown user/group 'root:root' on line 11
CONFIG_TMPFS=y



#### net driver dm9000
CONFIG_NET=y
CONFIG_NETDEVICES=y
CONFIG_ETHERNET=y
CONFIG_DM9000=y


#### root nfs
CONFIG_INET=y
CONFIG_IP_PNP=y
CONFIG_NETWORK_FILESYSTEMS=y
CONFIG_NFS_FS=y
CONFIG_ROOT_NFS=y



#### lcd
##device
CONFIG_S3C_DEV_FB=y
## lcd controller driver
CONFIG_FB=y
CONFIG_FB_S3C_EXT=y
CONFIG_FB_S3C_EXT_TFT480272=y
CONFIG_FB_S3C_EXT_BPP=y
CONFIG_FB_S3C_EXT_BPP_16=y
CONFIG_FB_S3C_EXT_NUM=1
CONFIG_FB_S3C_EXT_VIRTUAL_SCREEN=y
CONFIG_FB_S3C_EXT_DOUBLE_BUFFERING=y
## lcd module driver
CONFIG_LCD_WXCAT43=y
#console
CONFIG_FRAMEBUFFER_CONSOLE=y
```

## arch/arm/configs/ok6410A_sdboot_updating_defconfig
```kconfig
CONFIG_ARCH_MULTI_V6=y
CONFIG_ARCH_S3C64XX=y
CONFIG_MACH_SMDK6410=y
CONFIG_SERIAL_SAMSUNG=y
CONFIG_SERIAL_SAMSUNG_CONSOLE=y
CONFIG_MMC=y
CONFIG_MMC_SDHCI=y
CONFIG_MMC_SDHCI_S3C=y
CONFIG_EXT3_FS=y


#### add for mount: mdev: unknown user/group 'root:root' on line 11
CONFIG_TMPFS=y



#### net driver dm9000
CONFIG_NET=y
CONFIG_NETDEVICES=y
CONFIG_ETHERNET=y
CONFIG_DM9000=y


#### root nfs
CONFIG_INET=y
CONFIG_IP_PNP=y
CONFIG_NETWORK_FILESYSTEMS=y
CONFIG_NFS_FS=y
CONFIG_ROOT_NFS=y



#### lcd
##device
CONFIG_S3C_DEV_FB=y
## lcd controller driver
CONFIG_FB=y
CONFIG_FB_S3C_EXT=y
CONFIG_FB_S3C_EXT_TFT480272=y
CONFIG_FB_S3C_EXT_BPP=y
CONFIG_FB_S3C_EXT_BPP_16=y
CONFIG_FB_S3C_EXT_NUM=1
CONFIG_FB_S3C_EXT_VIRTUAL_SCREEN=y
CONFIG_FB_S3C_EXT_DOUBLE_BUFFERING=y
## lcd module driver
CONFIG_LCD_WXCAT43=y
#console
CONFIG_FRAMEBUFFER_CONSOLE=y

#### x11
CONFIG_UNIX=y


#### usb
CONFIG_USB=y
CONFIG_USB_OHCI_HCD=y
CONFIG_USB_OHCI_HCD_S3C2410=y

#### mouse keyboard interface
# mouse
CONFIG_INPUT_MOUSEDEV=y
# keyboard
CONFIG_HID_GENERIC=y



#### debug
CONFIG_DEBUG_KERNEL=y
CONFIG_DEBUG_LL=y
CONFIG_DEBUG_UNCOMPRESS=y

##### debug fs
CONFIG_DEBUG_FS=y
###### dynamic debug
CONFIG_DYNAMIC_DEBUG=y

#### uvc camera
CONFIG_MEDIA_SUPPORT=y
CONFIG_MEDIA_USB_SUPPORT=y
CONFIG_MEDIA_CAMERA_SUPPORT=y
CONFIG_VIDEO_DEV=y
CONFIG_I2C=y
CONFIG_VIDEO_V4L2=y
CONFIG_USB_VIDEO_CLASS=y
```

## drivers/video/samsung/Kconfig
```kconfig
config FB_S3C_EXT
	tristate "S3C Framebuffer Support (eXtended)"
	select FB_CFB_FILLRECT
	select FB_CFB_COPYAREA
	select FB_CFB_IMAGEBLIT
	depends on FB && (ARCH_S3C64XX || ARCH_S5P64XX || ARCH_S5PC1XX)

	default y if VIDEO_SAMSUNG

choice
	depends on FB_S3C_EXT
	prompt "Select LCD Type"
	default FB_S3C_EXT_TFT480272

config FB_S3C_EXT_TFT480272
	bool "4.3 inch 480x272 TFT LCD"
	help
	  4.3 inch 480x272 TFT LCD

config FB_S3C_EXT_TFT800480
	bool "7 inch 800x480 TFT LCD"
	help
		7 inch 800x480 TFT LCD

config FB_S3C_EXT_T240320
	bool "3.5 inch 240X320 Toppoly LCD"
	help
		3.5 inch 240X320 Toppoly LCD

config FB_S3C_EXT_X240320
	bool "3.5 inch 240X320 LCD(ACX502BMU)"
	help
		3.5 inch 240X320 LCD(ACX502BMU)

config FB_S3C_EXT_TFT640480
	bool "8 inch 640X480 L80 LCD"
	help
		8 inch 640X480 LCD

config FB_S3C_EXT_VGA1024768
	bool "VGA 1024x768"
	help
		VGA 1024x768

config FB_S3C_EXT_VGA800600
	bool "VGA 800x600"
	help
		VGA 800x600

config FB_S3C_EXT_VGA640480
	bool "VGA 640x480"
	help
		VGA 640x480

config FB_S3C_EXT_EZVGA800600
	bool "EZVGA 800x600"
	help
		EZVGA 800x600
endchoice

config FB_S3C_EXT_BPP
	tristate "Advanced options for S3C Framebuffer"
	depends on FB_S3C_EXT
	default n

choice
	depends on FB_S3C_EXT_BPP
	prompt "Select BPP(Bits Per Pixel)"
	default FB_S3C_EXT_BPP_16

config FB_S3C_EXT_BPP_8
	bool "8 BPP"

config FB_S3C_EXT_BPP_16
		bool "16 BPP"

config FB_S3C_EXT_BPP_24
		bool "24 BPP(XRGB888)"

config FB_S3C_EXT_BPP_28
		bool "28 BPP(ARGB4888)"

config FB_S3C_EXT_BPP_32
		bool "32 BPP(ARGB8888)"
endchoice

config FB_S3C_EXT_NUM
	int "Number of Framebuffers"
	depends on FB_S3C_EXT_BPP && (ARCH_S3C64XX || ARCH_S5P64XX || ARCH_S5PC1XX)
	default "1"

config FB_S3C_EXT_VIRTUAL_SCREEN
	bool "Enable Virtual Screen"
	depends on FB_S3C_EXT_BPP

	default n

config FB_S3C_EXT_DOUBLE_BUFFERING
	bool "Enable Double Buffering"
	depends on FB_S3C_EXT_BPP

	default n

config LCD_WXCAT43
	bool "Enable lcd WXCAT43 for s3c"
	depends on FB_S3C_EXT

	default n

	help
		lcd WXCAT43
```
